## config/boards/shields/schplit/Kconfig.defconfig
```kconfig
if SHIELD_SCHPLIT_LEFT

config ZMK_KEYBOARD_NAME
    default "Schplit"

config ZMK_SPLIT_ROLE_CENTRAL
    default y

config BOARD_ENABLE_DCDC
    default y

config ZMK_USB_LOGGING
    default y

config ZMK_USB
    default y


endif

if SHIELD_SCHPLIT_LEFT || SHIELD_SCHPLIT_RIGHT

config ZMK_SPLIT
    default y

endif
```

## config/boards/shields/schplit/Kconfig.shield
```kconfig
config SHIELD_SCHPLIT_LEFT
    def_bool $(shields_list_contains,schplit_left)

config SHIELD_SCHPLIT_RIGHT
    def_bool $(shields_list_contains,schplit_right)
```

## config/west.yml
```yaml
manifest:
  remotes:
    - name: zmkfirmware
      url-base: https://github.com/zmkfirmware
    - name: petejohanson
      url-base: https://github.com/petejohanson
  projects:
    - name: zmk
      remote: petejohanson
      revision: stephen/split-encoder
      import: app/west.yml
  self:
    path: config
```
